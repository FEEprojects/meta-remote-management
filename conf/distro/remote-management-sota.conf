## conf/distro/remote-management-sota.conf
```bitbake
include poky.conf

INHERIT += " sota"

DISTRO_NAME = "remote-management-sota"
DISTRO_VERSION = "1.1"
DISTRO_CODENAME = "remote-management-sota"

IMAGE_INSTALL_append = " connman connman-client"

RPI_USE_U_BOOT="1"

# add systemd to distro
DISTRO_FEATURES_append = " systemd pam virtualization wifi sota "
DISTRO_FEATURES_NATIVE_append = " sota"

VIRTUAL-RUNTIME_init_manager = "systemd"
VIRTUAL-RUNTIME_initscripts = "systemd-compat-units"
#add azure to distro CORE_IMAGE_EXTRA_INSTALL += "packagegroup-cloud-azure"
#CORE_IMAGE_EXTRA_INSTALL += "packagegroup-cloud-azure"
KERNEL_DEVICETREE += " overlays/pi3-disable-bt.dtbo overlays/pps-gpio.dtbo overlays/i2c-rtc.dtbo overlays/enable-spi.dtbo "

PACKAGECONFIG_append_pn-connman = " openvpn vpnc l2tp pptp"

USER_CLASSES_remove = "image-prelink"
VIRTUAL-RUNTIME_init_manager = "systemd"
VIRTUAL-RUNTIME_initscripts = "systemd-compat-units"

HOSTTOOLS_append = " sync sha256sum"

KERNEL_DEVICETREE_raspberrypi3_sota = " bcm2710-rpi-3-b.dtb overlays/vc4-kms-v3d.dtbo overlays/rpi-ft5406.dtbo overlays/i2c-rtc.dtbo overlays/pi3-disable-bt.dtbo overlays/pps-gpio.dtbo overlays/enable-spi.dtbo "
```

## conf/distro/remote-management.conf
```bitbake
include poky.conf

RPI_USE_U_BOOT="1"

# add systemd to distro
DISTRO_FEATURES_append = " systemd pam virtualization wifi "
VIRTUAL-RUNTIME_init_manager = "systemd"
VIRTUAL-RUNTIME_initscripts = "systemd-compat-units"
#add azure to distro CORE_IMAGE_EXTRA_INSTALL += "packagegroup-cloud-azure"
#CORE_IMAGE_EXTRA_INSTALL += "packagegroup-cloud-azure"
KERNEL_DEVICETREE += " overlays/spi-gpio-cs.dtbo  "

PACKAGECONFIG_append_pn-connman = " openvpn vpnc l2tp pptp"
```
